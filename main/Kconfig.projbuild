## main/Kconfig.projbuild
```kconfig
menu "网络服务配置"

    menu "WiFi 配置"
        config WIFI_SSID
            string "WiFi SSID（可选，用于开发测试）"
            default ""
            help
                WiFi 接入点 SSID（可选）。
                留空则使用 SmartConfig 配网或从 NVS 读取配置。

        config WIFI_PASSWORD
            string "WiFi 密码（可选，用于开发测试）"
            default ""
            help
                WiFi 接入点密码（可选）。
                留空则使用 SmartConfig 配网或从 NVS 读取配置。
    endmenu

    menu "MQTT 配置"
        config MQTT_BROKER_URL
            string "MQTT Broker URL"
            default "mqtts://xxx.emqxsl.cn:8883"
            help
                MQTT Broker URL（必需）。
                使用 mqtts:// 前缀启用 TLS 加密。
                示例：mqtts://xxx.emqxsl.cn:8883

        config MQTT_USERNAME
            string "MQTT 用户名"
            default "your_username"
            help
                MQTT Broker 用户名（必需）。

        config MQTT_PASSWORD
            string "MQTT 密码"
            default "your_password"
            help
                MQTT Broker 密码（必需）。
    endmenu

endmenu
```
